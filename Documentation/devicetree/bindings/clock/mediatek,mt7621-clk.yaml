## Documentation/devicetree/bindings/clock/mediatek,mt7621-clk.yaml
```yaml
# SPDX-License-Identifier: (GPL-2.0-only OR BSD-2-Clause)
%YAML 1.2
---
$id: http://devicetree.org/schemas/clock/mediatek,mt7621-clk.yaml#
$schema: http://devicetree.org/meta-schemas/core.yaml#

title: MT7621 Clock Device Tree Bindings

maintainers:
  - Sergio Paracuellos <sergio.paracuellos@gmail.com>

description: |
  The MT7621 has a PLL controller from where the cpu clock is provided
  as well as derived clocks for the bus and the peripherals. It also
  can gate SoC device clocks.

  Each clock is assigned an identifier and client nodes use this identifier
  to specify the clock which they consume.

  All these identifiers could be found in:
  [1]: <include/dt-bindings/clock/mt7621-clk.h>.

properties:
  compatible:
    const: mediatek,mt7621-clk

  "#clock-cells":
    description:
      The first cell indicates the clock number, see [1] for available
      clocks.
    const: 1

  clock-output-names:
    maxItems: 8

required:
  - compatible
  - '#clock-cells'

additionalProperties: false

examples:
  - |
    #include <dt-bindings/clock/mt7621-clk.h>

    pll {
      compatible = "mediatek,mt7621-clk";
      #clock-cells = <1>;
      clock-output-names = "xtal", "cpu", "bus",
                           "50m", "125m", "150m",
                           "250m", "270m";
    };
```

## Documentation/devicetree/bindings/extcon/extcon-gpio.txt
```
* Cable presence detector using GPIO

Required Properties:
 - compatible: "gpio-presence-detector"
 - gpios: gpio line that detects connector
 - debounce-delay-ms: debouncing delay

Example:

antenna-detect {
	compatible = "gpio-presence-detector";
	gpios = <&gpio5 16 0>;
	debounce-delay-ms = <10>;
};
```

## Documentation/devicetree/bindings/misc/wi2wi,w2cbw003.txt
```
wi2wi bluetooth module

This is access via a serial port and is largely controlled via that
link.  Extra configuration is needed to enable power on/off

Required properties:
- compatible: "wi2wi,w2cbw003"
- vdd-supply: regulator used to power the device.

The node for this device must be the child of a UART.

Example:

&uart1 {
       bluetooth {
               compatible = "wi2wi,w2cbw003";
               vdd-supply = <&vaux4>;
       };
};
```

## Documentation/devicetree/bindings/misc/wi2wi,w2sg0004.txt
```
wi2wi GPS device

This is access via a serial port and is largely controlled via that
link.  Extra configuration is needed to enable power on/off

Required properties:
- compatible: "wi2wi,w2sg0004"
- gpios: gpios used to toggle 'on/off' pin
- interrupts: interrupt generated by RX pin when device
      should be off

Optional properties:
- vdd-supply: regulator used to power antenna
- pinctrl: "default", "off"
      if "off" setting is provided it is imposed when device should
      be off.  This can route the RX pin to a GPIO interrupt.

The w2sg0004 uses a pin-toggle both to power-on and to
power-off, so the driver needs to detect what state it is in.
It does this by detecting characters on the RX line.
When it should be off, these can optionally be detected by a GPIO.

The node for this device must be the child of a UART.

Example:
&uart2 {
       gps {
               compatible = "wi2iw,w2sg0004";
               vdd-supply = <&vsim>;
               gpios = <&gpio5 17 0>; /* GPIO_145 */
               interrupts-extended = <&gpio5 19 0>; /* GPIO_147 */
               /* When off, switch RX to be an interrupt */
               pinctrl-names = "default", "off";
               pinctrl-0 = <&uart2_pins>;
               pinctrl-1 = <&uart2_pins_rx_gpio>;
       };
};
```

## Documentation/devicetree/bindings/net/mediatek-net-esw.txt
```
Ralink Fast Ethernet Embedded Switch
====================================

The ralink fast ethernet embedded switch can be found on Ralink and Mediatek
SoCs (RT3x5x, RT5350, MT76x8).

Required properties:
- compatible: Should be "ralink,rt3050-esw"
- reg: Address and length of the register set for the device
- interrupts: Should contain the embedded switches interrupt

Optional properties:
- mediatek,led_polarity: override the active high/low settings of the leds
- interrupt-parent: Should be the phandle for the interrupt controller
  that services interrupts for this device

Example:

esw@10110000 {
	compatible = "ralink,rt3050-esw";
	reg = <0x10110000 8000>;

	interrupt-parent = <&intc>;
	interrupts = <17>;
};
```

## Documentation/devicetree/bindings/serial/slave-reg.txt
```
Regulator powered UART-attached device

Required properties:
- compatible: "tty,regulator"
- vdd-supply: regulator to power the device


This is listed as a child node of a UART.  When the
UART is opened, the device is powered.

Example:

&uart1 {
	bluetooth {
		compatible = "tty,regulator";
		vdd-supply = <&vaux4>;
	};
};
```

## Documentation/devicetree/bindings/serial/slave-w2sg0004.txt
```
w2sg0004 UART-attached GPS receiver

Required properties:
- compatbile: "tty,w2sg0004"
- gpios: gpio used to toggle 'on/off' pin
- interrupts: interrupt generated by RX pin when device should
              be idle
- pinctrl: "default", "idle"
	     "idle" setting is active when device should be off.
	     This can remap the RX pin to a GPIO interrupt.

Optional properties:
- vdd-supply: regulator, e.g. to power antenna


The w2sg0004 uses a pin-toggle both to power-on and to
power-off, so the driver needs to detect what state it is in.
It does this by detecting characters on the RX line.
When it should be off, these can optionally be detected by a GPIO.

The node for this device must be the child of a UART.

Example:
&uart2 {
	gps {
		compatible = "tty,w2sg0004";
		vdd-supply = <&vsim>;
		gpios = <&gpio5 17 0>; /* GPIO_145 */
		interrupts-extended = <&gpio5 19 0>; /* GPIO_147 */
		/* When idle, switch RX to be an interrupt */
		pinctrl-names = "default", "idle";
		pinctrl-0 = <&uart2_pins>;
		pinctrl-1 = <&uart2_pins_rx_gpio>;
	};
};
```

## drivers/clk/ralink/Kconfig
```kconfig
# SPDX-License-Identifier: GPL-2.0-only
#
# MediaTek Mt7621 Clock Driver
#
menu "Clock driver for Mediatek mt7621 SoC"
	depends on SOC_MT7621

config CLK_MT7621
	bool "Clock driver for MediaTek MT7621"
	depends on SOC_MT7621
	default SOC_MT7621
	help
	  This driver supports MediaTek MT7621 basic clocks.
endmenu
```

## drivers/net/ethernet/mediatek/Kconfig
```kconfig
config NET_VENDOR_MEDIATEK
	bool "MediaTek ethernet driver"
	depends on RALINK || ARCH_MEDIATEK
	---help---
	  If you have a Mediatek SoC with ethernet, say Y.

if NET_VENDOR_MEDIATEK

config NET_MEDIATEK_SOC
	tristate "MediaTek SoC Gigabit Ethernet support"
	depends on NET_VENDOR_MEDIATEK
	select PHYLIB
	---help---
	  This driver supports the gigabit ethernet MACs in the
	  MediaTek SoC family.

choice
	prompt "MAC type"

config NET_MEDIATEK_RT2880
	bool "RT2882"
	depends on MIPS && SOC_RT288X

config NET_MEDIATEK_RT3050
	bool "RT3050/MT7628"
	depends on MIPS && (SOC_RT305X || SOC_MT7620)

config NET_MEDIATEK_RT3883
	bool "RT3883"
	depends on MIPS && SOC_RT3883

config NET_MEDIATEK_MT7620
	bool "MT7620"
	depends on MIPS && SOC_MT7620

config NET_MEDIATEK_MT7621
	bool "MT7621"
	depends on MIPS && SOC_MT7621

config NET_MEDIATEK_MT7623
	bool "MT7623"
	depends on ARM && MACH_MT7623

endchoice

config NET_MEDIATEK_MDIO
	def_bool NET_MEDIATEK_SOC
	depends on (NET_MEDIATEK_RT2880 || NET_MEDIATEK_RT3883 || NET_MEDIATEK_MT7620 || NET_MEDIATEK_MT7621 || NET_MEDIATEK_MT7623)
	select PHYLIB

config NET_MEDIATEK_MDIO_RT2880
	def_bool NET_MEDIATEK_SOC
	depends on (NET_MEDIATEK_RT2880 || NET_MEDIATEK_RT3883)
	select NET_MEDIATEK_MDIO

config NET_MEDIATEK_MDIO_MT7620
	def_bool NET_MEDIATEK_SOC
	depends on (NET_MEDIATEK_MT7620 || NET_MEDIATEK_MT7621 || NET_MEDIATEK_MT7623)
	select NET_MEDIATEK_MDIO

config NET_MEDIATEK_ESW_RT3050
	def_tristate NET_MEDIATEK_SOC
	depends on NET_MEDIATEK_RT3050

config NET_MEDIATEK_GSW_MT7620
	def_tristate NET_MEDIATEK_SOC
	depends on NET_MEDIATEK_MT7620

config NET_MEDIATEK_GSW_MT7621
	def_tristate NET_MEDIATEK_SOC
	depends on NET_MEDIATEK_MT7621

config NET_MEDIATEK_GSW_MT7623
	def_tristate NET_MEDIATEK_SOC
	depends on NET_MEDIATEK_MT7623
endif

endif #NET_VENDOR_MEDIATEK
```

## drivers/staging/mt7621-dts/Kconfig
```kconfig
config DTB_GNUBEE1
	bool "GnuBee1 NAS - 2.5inch"
	depends on SOC_MT7621 && DTB_RT_NONE
	select BUILTIN_DTB

config DTB_GNUBEE2
	bool "GnuBee2 NAS - 3.5inch"
	depends on SOC_MT7621 && DTB_RT_NONE
	select BUILTIN_DTB
```

## drivers/staging/mt7621-pci/Kconfig
```kconfig
config PCI_MT7621
	def_bool y if SOC_MT7621 && PCI
	select PCI_DRIVERS_GENERIC
	help
	  This selects a driver for the MediaTek MT7621 PCI Controller.
```

## drivers/tty/slaves/Kconfig
```kconfig
menuconfig TTY_SLAVE
	bool "TTY slave devices"
	help
	 Devices which attach via a uart, but need extra
	 driver support for power management etc.

if TTY_SLAVE

config TTY_SLAVE_REGULATOR
	tristate "TTY slave device powered by regulator"

config TTY_SLAVE_W2SG0004
	tristate "W2SG0004 GPS on/off control"
	help
	  Enable on/off control of W2SG0004 GPS when attached
	  to a UART.

endif
```

## net/lnet/Kconfig
```kconfig
config LNET
	tristate "Lustre networking subsystem (LNet)"
	depends on INET
	help
	  The Lustre network layer, also known as LNet, is a networking abstaction
	  level API that was initially created to allow Lustre Filesystem to utilize
	  very different networks like tcp and ib verbs in a uniform way. In the
	  case of Lustre routers only the LNet layer is required. Lately other
	  projects are also looking into using LNet as their networking API as well.
```
